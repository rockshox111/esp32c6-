## esp32c6_147_rtos_ui/sdkconfig.defaults
```kconfig
CONFIG_IDF_TARGET_ESP32C6=y
CONFIG_FREERTOS_HZ=1000
CONFIG_FREERTOS_GENERATE_RUN_TIME_STATS=y
CONFIG_FREERTOS_RUN_TIME_STATS_USING_ESP_TIMER=y
CONFIG_FREERTOS_USE_TRACE_FACILITY=y
CONFIG_FREERTOS_USE_STATS_FORMATTING_FUNCTIONS=y
CONFIG_FREERTOS_CHECK_STACKOVERFLOW=y
CONFIG_SPIRAM_NONE=y
CONFIG_LVGL_ENABLED=y
CONFIG_LV_USE_PERF_MONITOR=y
CONFIG_LV_USE_MEM_MONITOR=y
CONFIG_FATFS_LONG_FILENAMES=y
CONFIG_FATFS_MAX_LONG_FILENAME=255
CONFIG_ESP_MAIN_TASK_STACK_SIZE=8192
```
